## conf/layer.conf
```bitbake
BBPATH .= ":${LAYERDIR}"

BBFILES += "${LAYERDIR}/recipes-*/*/*.bb \
            ${LAYERDIR}/recipes-*/*/*.bbappend"

BBFILE_COLLECTIONS += "example"

BBFILE_PATTERN_example = "^${LAYERDIR}/"
BBFILE_PRIORITY_example = "97"
LAYERVERSION_example = "1"
```
